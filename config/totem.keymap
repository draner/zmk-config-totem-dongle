#include <behaviors.dtsi>
#include <dt-bindings/zmk/bt.h>
#include <dt-bindings/zmk/keys.h>
#include <dt-bindings/zmk/outputs.h>

#include "aekeynox_settings.h"

/*
 * SELENIUM_KEYMAP_BINDINGS for Totem (38 keys)
 *
 * This macro maps the Ækeynox 42-key layout to the Totem 38-key matrix.
 * Row 3 extensions (LOUT3/ROUT3) are mapped to Shift.
 */
#define SELENIUM_KEYMAP_BINDINGS(LOUT1, LROW1, RROW1, ROUT1, \
                                 LOUT2, LROW2, RROW2, ROUT2, \
                                 LOUT3, LROW3, RROW3, ROUT3, \
                                 LT1, LT2, LT3, RT3, RT2, RT1) \
                 LROW1 RROW1 \
                 LROW2 RROW2 \
           &kp LSHFT LROW3 RROW3 &kp RSHFT \
           LT3 LT2 LT1 RT1 RT2 RT3

#define CI_IGNORE_USER_SETTINGS
#include <aekeynox/selenium.keymap>

/ {
    combos {
        compatible = "zmk,combos";

        combo_esc {
            timeout-ms = <50>;
            key-positions = <0 1>;
            bindings = <&kp ESC>;
        };

        combo_studio_unlock {
            timeout-ms = <50>;
            key-positions = <34 35>;
            bindings = <&studio_unlock>;
        };
    };
};
