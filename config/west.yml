## config/west.yml
```yaml
manifest:
  remotes:
    - name: zmkfirmware
      url-base: https://github.com/zmkfirmware
    - name: englmaxi
      url-base: https://github.com/englmaxi
    - name: onedeadkey
      url-base: https://github.com/OneDeadKey
  projects:
    - name: zmk
      remote: zmkfirmware
      revision: main
      import: app/west.yml
    - name: zmk-dongle-display
      remote: englmaxi
      revision: main
    - name: zmk-config-aekeynox
      remote: onedeadkey
      revision: main
  self:
    path: config
```
